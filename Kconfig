## Kconfig
```kconfig
config PANDAKB_LED_TEST
    bool "LED test pattern: white chase, then cumulative fill"
    depends on !ZMK_RGB_UNDERGLOW
    select LED_STRIP
    help
      Boot-time LED test for the zmk,underglow strip. Lights one white LED
      at a time in order, then lights them one by one until all are on,
      and repeats. Requires RGB underglow to be disabled so nothing else
      drives the strip.

if PANDAKB_LED_TEST

config PANDAKB_LED_TEST_STEP_MS
    int "Delay between steps (ms)"
    default 200

config PANDAKB_LED_TEST_BRIGHTNESS
    int "White brightness per channel (0-255)"
    range 1 255
    default 64

endif
```

## config/west.yml
```yaml
manifest:
  remotes:
    - name: zmkfirmware
      url-base: https://github.com/zmkfirmware
  #additional module
    - name: petejohanson
      url-base: https://github.com/petejohanson
    - name: gpeye
      url-base: https://github.com/GPeye
    - name: mctechnology17
      url-base: https://github.com/mctechnology17
    - name: kevinpastor
      url-base: https://github.com/kevinpastor
    - name: m165437
      url-base: https://github.com/M165437
    - name: s6t
      url-base: https://github.com/s6t
    - name: infely
      url-base: https://github.com/infely
    - name: penguinchat
      url-base: https://github.com/penguinchat
    - name: englmaxi
      url-base: https://github.com/englmaxi
    - name: stubbleman
      url-base: https://github.com/Stubbleman
  projects:
    - name: zmk
      remote: zmkfirmware
      revision: v0.3
      import: app/west.yml
  #additional module
    - name: hammerbeam-slideshow
      remote: gpeye
      revision: main
    - name: zmk-nice-oled
      remote: stubbleman
      repo-path: zmk-for-PandaKB
      revision: 87b99691eeb63ee18b19f9aecb53a5cee537231a # nice-oled-fast-rotate
    - name: nice-view-elemental
      remote: kevinpastor
      revision: main
    - name: nice-view-gem
      remote: m165437
      revision: main
    - name: zmk-shield-nice-view-cats
      remote: s6t
      revision: main
    - name: nice-view-battery
      remote: infely
      revision: main
    - name: zmk-dongle-screen
      remote: penguinchat
      revision: Penguinchat-patch-1
    - name: zmk-for-PandaKB.com-
      remote: penguinchat
      revision: PandaKB_Lily58
    - name: zmk-dongle-display
      remote: englmaxi
      revision: v0.3
  self:
    path: config
```
